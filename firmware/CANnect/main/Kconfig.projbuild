## firmware/CANnect/main/Kconfig.projbuild
```kconfig
menu "CANnect"

config CAN_TX_GPIO
    int "CAN TX GPIO"
    range -1 48
    default -1
    help
        ESP32-S3 GPIO connected to the CAN transceiver TXD input.
        Set to a valid GPIO before using the CAN adapter.

config CAN_RX_GPIO
    int "CAN RX GPIO"
    range -1 48
    default -1
    help
        ESP32-S3 GPIO connected to the CAN transceiver RXD output.
        Set to a valid GPIO before using the CAN adapter.

config CAN_BITRATE
    int "CAN bitrate (bits per second)"
    range 10000 1000000
    default 500000
    help
        CAN bitrate used by the hardware and accepted by python-can's
        SLCAN bitrate command. Reconfigure this value to change the rate.

endmenu
```

## firmware/CANnect/sdkconfig.defaults
```kconfig
CONFIG_ESPTOOLPY_FLASHSIZE_16MB=y
CONFIG_TINYUSB_CDC_ENABLED=y
CONFIG_TINYUSB_CDC_COUNT=1
```
